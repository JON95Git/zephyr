## CMakeLists.txt
```
# SPDX-License-Identifier: Apache-2.0

cmake_minimum_required(VERSION 3.20.0)

find_package(Zephyr REQUIRED HINTS $ENV{ZEPHYR_BASE})
project(lvgl)

FILE(GLOB app_sources src/*.c
    src/gui/gui_app.c
    src/gui/screen_tabs/gui_mass_storage_tab.c
    src/gui/screen_tabs/gui_random_tab.c
    src/gui/components/gui_spinbox.c
    src/gui/components/gui_widgets.c
)
target_sources(app PRIVATE ${app_sources})
```

## prj.conf
```kconfig
CONFIG_DISPLAY=y
CONFIG_DISPLAY_LOG_LEVEL_ERR=y

CONFIG_LOG=y

CONFIG_LVGL=y
CONFIG_LV_MEM_CUSTOM=y
CONFIG_LV_USE_LOG=y
CONFIG_LV_USE_LABEL=y
CONFIG_LV_USE_BTN=y
CONFIG_LV_USE_SPINBOX=y
CONFIG_LV_USE_TEXTAREA=y
CONFIG_LV_USE_KEYBOARD=y
CONFIG_LV_USE_SPINNER=y
CONFIG_LV_USE_ARC=y
CONFIG_LV_USE_MSGBOX=y
CONFIG_LV_Z_BITS_PER_PIXEL=16

# extra memory needed for storage of LVGL's GUI elements
# CONFIG_HEAP_MEM_POOL_SIZE=262144 -> not needed, LVGL uses its own heap memory pool whose size is defined below
CONFIG_MAIN_STACK_SIZE=4096
CONFIG_LV_Z_MEM_POOL_MAX_SIZE=16384
CONFIG_LV_Z_MEM_POOL_NUMBER_BLOCKS=4
```

## boards/stm32f746g_disco.conf
```kconfig
CONFIG_LV_Z_POINTER_KSCAN=y
CONFIG_LV_Z_POINTER_KSCAN_DEV_NAME="FT5336"
```

## src/main.c
```c
/*
 * Copyright (c) 2018 Jan Van Winkel <jan.van_winkel@dxplore.eu>
 *
 * SPDX-License-Identifier: Apache-2.0
 */

#include <device.h>
#include <drivers/display.h>
#include <lvgl.h>
#include <stdio.h>
#include <string.h>
#include <zephyr.h>
#include "gui/gui_app.h"

#define LOG_LEVEL CONFIG_LOG_DEFAULT_LEVEL
#include <logging/log.h>
LOG_MODULE_REGISTER(app);

void main(void)
{
	const struct device *display_dev;
	display_dev = DEVICE_DT_GET(DT_CHOSEN(zephyr_display));
	if (!device_is_ready(display_dev)) {
		LOG_ERR("Device not ready, aborting test");
		return;
	}

	lv_task_handler();
	display_blanking_off(display_dev);

	gui_app();

	while (1) {
		lv_task_handler();
		k_sleep(K_MSEC(5));
	}
}
```
